.ORG 0x0000
JMP START

.ORG 0x0036
JMP TRANSCOMPLETED

START:

LDI R16,(1<<PE1)
OUT DDRE,R16 ;SALIDA

BCLR 7 ;FLAG INTERRUPT CLEARED
CLI ;GLOBAL INTERRUPT DISABLE

LDS R16,0xC0 ;UCSR0A DIRECTION
CBR R16,6 ;CLEARED BIT 6 USCR0A
STS 0xC0,R16 ;STORE R16 IN USCR0A

LDS R16,0xC1 ;UCSR0B
CBR R16,0x03
STS 0xC1,R16

LDI R16,(1<<U2X0)
STS UCSR0A,R16
LDI R16,(1<<TXEN0)|(1<<TXCIE0)
STS UCSR0B,R16 ;MODO TRANSMISIÓN USART,INTERRUPCIONES POR TRANS=ENABLE
LDS R16,0xC1
LDI R16,(0<<UMSEL01)|(0<<UMSEL00)|(1<<UCSZ01)|(1<<UCSZ00)
STS UCSR0C,R16 ;MODO ASINCRONO USART,TAMAÑO DE DATO=8BITS
LDI R16,207 ;103 ->>VELOCIDAD DE 9600 BAUDIOS (BITS POR SEGUNDO)
STS 0xC4,R16
SEI

REGVACIO3:
LDS R16,0xC0  ;UCSR0A REGISTER DIRECTION
SBRS R16,5 ;SKIP NEXT INTRUCTION IF BIT 5 IS SET
JMP REGVACIO3

LDI R16,0B00000001 ;"E"
STS 0xC6,R16 ;UDR0

LDS R16,0xC6

LDS R16,0xC0 ;UCSR0A
CBR R16,5
STS 0xC0,R16

ESPERAR:
JMP ESPERAR

TRANSCOMPLETED:
REGVACIO:
LDS R16,0xC0  ;UCSR0A REGISTER DIRECTION
SBRS R16,5 ;SKIP NEXT INTRUCTION IF BIT 5 IS SET
JMP REGVACIO

LDI R16,0B00000001 ;"E"
STS 0xC6,R16 ;UDR0

LDS R16,0xC0 ;UCSR0A
CBR R16,5
STS 0xC0,R16
RETI


